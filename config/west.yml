## config/west.yml
```yaml
manifest:
  remotes:
    - name: zmkfirmware
      # url-base: https://github.com/zmkfirmware
      url-base: https://github.com/urob
  projects:
    - name: zmk
      # remote: zmkfirmware
      remote: urob
      revision: main
      import: app/west.yml
  self:
    path: config
```
